/*
 * Copyright (c) 2020 The ZMK Contributors
 *
 * SPDX-License-Identifier: MIT
 */

#include <behaviors.dtsi>
#include <dt-bindings/zmk/keys.h>
#include <dt-bindings/zmk/bt.h>
#include <dt-bindings/zmk/backlight.h>
#include <dt-bindings/zmk/rgb.h>

&led_strip {
    chain-length = <27>;
};

behaviors {
        rgb_ug_behavior: rgb_underglow { // Cambié rgb_ug a rgb_ug_behavior
            compatible = "zmk,behavior-rgb-underglow";
            label = "RGB_UG";
            #binding-cells = <0>;
        };
    };

/ {
    keymap {
        compatible = "zmk,keymap";

        default_layer {
            bindings = <
                &kp TAB   &kp Q &kp W &kp E &kp R &kp T   &kp Y &kp U  &kp I     &kp O   &kp P    &kp BSPC
                &kp LCTRL &kp A &kp S &kp D &kp F &kp G   &kp H &kp J  &kp K     &kp L   &kp SEMI &kp SQT
                &kp LSHFT &kp Z &kp X &kp C &kp V &kp B   &kp N &kp M  &kp COMMA &kp DOT &kp FSLH &kp ESC
                          &kp LGUI &mo 1 &kp SPACE   &kp RET &mo 2 &kp RALT
            >;
        };

        lower_layer {
            bindings = <
                &kp TAB    &kp N1       &kp N2       &kp N3       &kp N4       &kp N5         &kp N6   &kp N7   &kp N8 &kp N9    &kp N0 &kp BSPC
                &bt BT_CLR &bt BT_SEL 0 &bt BT_SEL 1 &bt BT_SEL 2 &bt BT_SEL 3 &bt BT_SEL 4   &kp LEFT &kp DOWN &kp UP &kp RIGHT &trans &trans
                &kp LSHFT  &trans       &trans       &trans       &trans       &trans         &trans   &trans   &trans &trans    &trans &trans
                                        &kp LGUI     &trans       &kp SPACE      &kp RET  &trans   &kp RALT
            >;
        };

        raise_layer {
// -----------------------------------------------------------------------------------------
// |  TAB |   !   |   @   |   #   |   $   |   %   |   |  ^  |  &  |  *  |  (  |  )  | BKSP |
// | CTRL |RGB_TOG|RGB_HUI|RGB_SAI|RGB_VAI|       |   |  -  |  =  |  [  |  ]  |  \  |  `   |
// | SHFT |RGB_MOD|RGB_HUD|RGB_SAD|RGB_VAD|QK_BOOT|   |  _  |  +  |  {  |  }  | "|" |  ~   |
//                            | GUI |     |  SPC  |   | ENT |     | ALT |
                        bindings = <
   &kp  TAB  &kp EXCL &kp AT &kp HASH &kp DLLR &kp PRCNT   &kp CARET &kp AMPS  &kp KP_MULTIPLY &kp LPAR &kp RPAR &kp BSPC
   &kp LCTRL &rgb_ug_behavior  RGB_TOG   &rgb_ug_behavior RGB_HUI &rgb_ug_behavior RGB_SAI   &rgb_ug_behavior RGB_BRI   &trans      &kp MINUS &kp EQUAL &kp LBKT        &kp RBKT &kp BSLH &kp GRAVE
   &kp LSHFT &rgb_ug_behavior RGB_EFF   &rgb_ug_behavior RGB_HUD &rgb_ug_behavior RGB_SAD   &rgb_ug_behavior RGB_BRD   &bootloader      &kp UNDER &kp PLUS  &kp LBRC        &kp RBRC &kp PIPE &kp TILDE
                             &kp LGUI &trans   &kp SPACE   &kp RET   &trans    &kp RALT
                        >;
                };
    };
};
